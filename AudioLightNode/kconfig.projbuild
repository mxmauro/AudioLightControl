## AudioLightNode/kconfig.projbuild
```kconfig
mainmenu "AudioLight Node configuration"

    config USE_ONBOARD_LED_GPIO
        bool "Use the onboard LED"
        default n
        help
            This option enables the onboard LED GPIO.

    config ONBOARD_LED_GPIO_PIN
        int "Onboard LED GPIO pin"
        depends on USE_ONBOARD_LED_GPIO
        help
            GPIO pin number for the onboard LED.
        range 0 31
        default 8
```

## AudioLightNode5050/sdkconfig.defaults
```kconfig
# Partition Table
#
CONFIG_ESPTOOLPY_FLASHSIZE_4MB=y
CONFIG_PARTITION_TABLE_CUSTOM=y
CONFIG_PARTITION_TABLE_CUSTOM_FILENAME="partitions/partition_table.csv"
# CONFIG_PARTITION_TABLE_FILENAME="partitions/partition_table.csv"
CONFIG_PARTITION_TABLE_OFFSET=0x8000
CONFIG_PARTITION_TABLE_MD5=y

# NVS
CONFIG_NVS_ENCRYPTION=y
CONFIG_NVS_SEC_KEY_PROTECT_USING_HMAC=y
CONFIG_NVS_SEC_HMAC_EFUSE_KEY_ID=0

# HTTP Server
#
CONFIG_HTTPD_WS_SUPPORT=y
CONFIG_HTTPD_WS_PRE_HANDSHAKE_CB_SUPPORT=y

# Kernel
#
CONFIG_FREERTOS_UNICORE=y
CONFIG_FREERTOS_CHECK_STACKOVERFLOW_PTRVAL=y

# ESP System Settings
#
CONFIG_ESP_SYSTEM_EVENT_TASK_STACK_SIZE=4096

# Power Management
#
CONFIG_PM_SLEEP_FUNC_IN_IRAM=y

# Compiler options
#
CONFIG_COMPILER_FLOAT_LIB_FROM_GCCLIB=y

# Log
#
CONFIG_LOG_VERSION_2=y
```
